## main/Kconfig.projbuild
```kconfig
menu "BiJin ToKei Configuration"

config EXAMPLE_DISPLAY_TYPE
    int
    default 0 if EXAMPLE_DISPLAY_TYPE0
    default 1 if EXAMPLE_DISPLAY_TYPE1
    default 2 if EXAMPLE_DISPLAY_TYPE2

    choice
        prompt "Select predefined display configuration"
        default EXAMPLE_DISPLAY_TYPE0
        help
            Select predefined display configuration
    
        config EXAMPLE_DISPLAY_TYPE0
            bool "None"
        config EXAMPLE_DISPLAY_TYPE1
            bool "ESP-WROVER-KIT Display"
        config EXAMPLE_DISPLAY_TYPE2
            bool "Adafruit TFT Feather display"
    endchoice

config WIFI_SSID
    string "WiFi SSID"
    default "myssid"
    help
	SSID (network name) for the demo to connect to.

config WIFI_PASSWORD
    string "WiFi Password"
    default "mypassword"
    help
	WiFi password (WPA or WPA2) for the demo to use.

endmenu
```

## sdkconfig.defaults
```kconfig
CONFIG_PARTITION_TABLE_CUSTOM=y
CONFIG_PARTITION_TABLE_CUSTOM_FILENAME="partitions.csv"
CONFIG_PARTITION_TABLE_CUSTOM_APP_BIN_OFFSET=0x10000
CONFIG_PARTITION_TABLE_FILENAME="partitions.csv"
CONFIG_APP_OFFSET=0x10000
CONFIG_ESP32_PANIC_PRINT_HALT=y
CONFIG_ESP32_DEFAULT_CPU_FREQ_240=y
CONFIG_FREERTOS_HZ=1000
CONFIG_MAIN_TASK_STACK_SIZE=8192
CONFIG_TASK_WDT_TIMEOUT_S=20
CONFIG_BOOTLOADER_SPI_WP_PIN=7
CONFIG_ESPTOOLPY_BAUD_921600B=y
CONFIG_ESPTOOLPY_BAUD=921600
CONFIG_FLASHMODE_QIO=y
CONFIG_ESPTOOLPY_FLASHFREQ_80M=y
CONFIG_ESPTOOLPY_FLASHFREQ="80m"
CONFIG_ESPTOOLPY_FLASHSIZE_4MB=y
CONFIG_ESPTOOLPY_FLASHSIZE="4MB"
CONFIG_ESP32_PANIC_PRINT_REBOOT=y
```
